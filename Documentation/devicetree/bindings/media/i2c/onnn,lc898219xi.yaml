## Documentation/devicetree/bindings/media/i2c/onnn,lc898219xi.yaml
```yaml
# SPDX-License-Identifier: (GPL-2.0-only OR BSD-2-Clause)
# Copyright 2025 Vasiliy Doylov <nekocwd@mainlining.org>
# Copyright 2026 Frieder Hannenheim <kernel@fhannenheim.net>
%YAML 1.2
---
$id: http://devicetree.org/schemas/media/i2c/onnn,lc898219xi.yaml##
$schema: http://devicetree.org/meta-schemas/core.yaml#

title: ON Semiconductor LC898219XI Voice Coil Motor (VCM) Lens

maintainers:
  - Frieder Hannenheim <kernel@fhannenheim.net>

description:
  The LC898219XI is a 12-bit digital-to-analog (DAC) converter.
  VCM current is controlled with a linear mode driver.The DAC is controlled
  via a 2-wire (I2C-compatible) serial interface that operates at clock
  rates up to 1MHz. This chip integrates Advanced Actuator Control (AAC)
  technology and is intended for driving voice coil lenses in camera modules.

properties:
  compatible:
    enum:
      - onnn,lc898219xi

  reg:
    maxItems: 1

  vcc-supply:
    description:
      Definition of the regulator used as voltage supply.

required:
  - compatible
  - reg
  - vcc-supply

additionalProperties: false

examples:
  - |
    i2c {
        #address-cells = <1>;
        #size-cells = <0>;

        camera-lens@74 {
            compatible = "onnn,lc898219xi";
            reg = <0x72>;

            vcc-supply = <&mt6358_vcamio_reg>;
        };
    };

...
```

## Documentation/devicetree/bindings/pinctrl/qcom,sdm670-lpass-lpi-pinctrl.yaml
```yaml
# SPDX-License-Identifier: (GPL-2.0-only OR BSD-2-Clause)
%YAML 1.2
---
$id: http://devicetree.org/schemas/pinctrl/qcom,sdm670-lpass-lpi-pinctrl.yaml#
$schema: http://devicetree.org/meta-schemas/core.yaml#

title: Qualcomm SDM670 SoC LPASS LPI TLMM

maintainers:
  - Richard Acayan <mailingradian@gmail.com>
    # Maybe?
  - Srinivas Kandagatla <srinivas.kandagatla@linaro.org>

description:
  Top Level Mode Multiplexer pin controller in the Low Power Audio SubSystem
  (LPASS) Low Power Island (LPI) of Qualcomm SDM670 SoC.

properties:
  compatible:
    const: qcom,sdm670-lpass-lpi-pinctrl

  reg:
    items:
      - description: LPASS LPI TLMM Control and Status registers

  qcom,adsp-bypass-mode: true

patternProperties:
  "-state$":
    oneOf:
      - $ref: "#/$defs/qcom-sdm670-lpass-state"
      - patternProperties:
          "-pins$":
            $ref: "#/$defs/qcom-sdm670-lpass-state"
        additionalProperties: false

$defs:
  qcom-sdm670-lpass-state:
    type: object
    description:
      Pinctrl node's client devices use subnodes for desired pin configuration.
      Client device subnodes use below standard properties.
    $ref: qcom,lpass-lpi-common.yaml#/$defs/qcom-tlmm-state
    unevaluatedProperties: false

    properties:
      pins:
        description:
          List of gpio pins affected by the properties specified in this
          subnode.
        items:
          pattern: "^gpio([0-9]|1[0-9]|2[0-6])$"

      function:
        enum: [ gpio, comp_rx, dmic12, dmic34, lpi_cdc_rst, mclk0, pdm_2_gpios,
                pdm_clk, pdm_rx, pdm_sync, sec_tdm, sec_tdm_din, sec_tdm_dout ]
        description:
          Specify the alternative function to be configured for the specified
          pins.

allOf:
  - $ref: qcom,lpass-lpi-common.yaml#

required:
  - compatible
  - reg

unevaluatedProperties: false

examples:
  - |
    lpi_tlmm: pinctrl@62b40000 {
        compatible = "qcom,sdm670-lpass-lpi-pinctrl";
        reg = <0 0x62b40000 0 0x20000>;
        qcom,adsp-bypass-mode;
        gpio-controller;
        #gpio-cells = <2>;
        gpio-ranges = <&lpi_tlmm 0 0 32>;
    };
```
